## app/display/Kconfig.projbuild
```kconfig
config GPIO_DISPLAY_MOSI
    int "Display SPI MOSI number"
    default 18

config GPIO_DISPLAY_CS
    int "Display SPI CS number"
    default 33

config GPIO_DISPLAY_SCK
    int "Display SPI SCK number"
    default 19

config GPIO_DISPLAY_RST
    int "Display RST number"
    default 32

config GPIO_DISPLAY_DC
    int "Display DC number"
    default 5

config GPIO_DISPLAY_BL
    int "Display BL number"
    default -1
```

## app/keyboard/Kconfig.projbuild
```kconfig
config GPIO_KEYBOARD_CLK 
    int "Keyboard shift registers CLK number"
    default 2

config GPIO_KEYBOARD_SIPO_DS
    int "Keyboard SIPO DS number"
    default 4
    
config GPIO_KEYBOARD_SIPO_LH
    int "Keyboard SIPO LH number"
    default 15

config GPIO_KEYBOARD_PISO_LH
    int "Keyboard PISO LH number"
    default 23
    
config GPIO_KEYBOARD_PISO_DS
    int "Keyboard PISO DS number"
    default 35
```

## app/sdcard/Kconfig.projbuild
```kconfig
config GPIO_SD_MISO
    int "SD MISO number"
    default 13

config GPIO_SD_MOSI
    int "SD MOSI number"
    default 14

config GPIO_SD_CS
    int "SD CS number"
    default 27

config GPIO_SD_CLK
    int "SD CLK number"
    default 26

config MOUNT_POINT
    string "SD Card mount point"
    default "/sdcard"
```

## main/Kconfig.projbuild
```kconfig
config GPIO_SLEEP_WKUP
    int "Sleep Wakeup"
    default 2

config LIGHT_SLEEP_TIMEOUT
    int "Enter Light Sleep Timeout (sec)"
    default 30

config DEEP_SLEEP_TIMEOUT
    int "Enter Light Sleep Timeout (sec)"
    default 900
```
